## CMakeLists.txt
```
# SPDX-License-Identifier: Apache-2.0

cmake_minimum_required(VERSION 3.13.1)
find_package(Zephyr REQUIRED HINTS $ENV{ZEPHYR_BASE})
project(thesis)


set(MY_LIB ${CMAKE_CURRENT_SOURCE_DIR}/../../mylib)

include_directories(include)

MACRO(SUBDIRLIST result curdir)
  FILE(GLOB children RELATIVE ${curdir} ${curdir}/*)
  SET(dirlist "")
  
  FOREACH(child ${children})
    IF(IS_DIRECTORY ${curdir}/${child})
      LIST(APPEND dirlist ${child})
    ENDIF()
  ENDFOREACH()
  SET(${result} ${dirlist})
ENDMACRO()


SUBDIRLIST(DIRECTORY_LIST ${MY_LIB})

foreach(dir ${DIRECTORY_LIST})
    include_directories(${MY_LIB}/${dir}/include)
    file(GLOB_RECURSE SRCS ${MY_LIB}/${dir}/src/*.c)
    foreach(source ${SRCS})
        target_sources(app PRIVATE ${source})
    endforeach()
endforeach()


add_definitions(-DPROJECT)


target_sources(app PRIVATE ${proto_sources} src/main.c)
set(CMAKE_EXPORT_COMPILE_COMMANDS ON)
```

## Kconfig
```
# Copyright (c) 2019 Nordic Semiconductor ASA
# SPDX-License-Identifier: Apache-2.0






source "Kconfig.zephyr"
```

## prj.conf
```kconfig
CONFIG_SERIAL=y

CONFIG_HEAP_MEM_POOL_SIZE=1024

CONFIG_THREAD_NAME=y
```

## boards/nucleo_l152re.conf
```kconfig
CONFIG_PRINTK=y

CONFIG_LOG=y

CONFIG_INIT_STACKS=y
CONFIG_THREAD_STACK_INFO=y
CONFIG_KERNEL_SHELL=y
CONFIG_THREAD_MONITOR=y
CONFIG_BOOT_BANNER=n
CONFIG_THREAD_NAME=y

CONFIG_DEVICE_SHELL=y

CONFIG_HEAP_MEM_POOL_SIZE=512

CONFIG_GPIO=y
```

## boards/disco_l475_iot1.overlay
```dts
/*
 * Copyright (c) 2020, Nordic Semiconductor ASA
 *
 * SPDX-License-Identifier: Apache-2.0
 */

/* overlay file for the disco_l475_iot1 to overwrite SPI */

&usart3 {
	status = "okay";
	pinctrl-0 = < &usart3_tx_pc4 &usart3_rx_pc5 >;
	current-speed = < 0x1c200 >;
};

&uart4 {
	
	current-speed = < 57600 >;
};
```

## boards/nucleo_l152re.overlay
```dts
&usart1 {
     status = "okay";
     current-speed = < 0x1c200 >;
     pinctrl-0 = < &usart1_tx_pa9 &usart1_rx_pa10 >;
};
```

## src/main.c
```c
/**   
 ***************************************************************
 * @file    apps/thesis/src/main.c    
 * @author  Lewis Ainslie - s4485827  
 * @date    08/11/2021   
 * @brief   Main file enabling all functionality for different devices
 ***************************************************************
 */

#include "main.h"
#include "os_zedf9p.h"
#include "os_mdot.h"


/* 
 * Main function initialising all hardware and threads.
 */
void main(void) {

	int ret;

	do {
		ret = 0;
		ret += hal_init_mdot();
		ret += hal_init_zedf9p();
		k_msleep(1000);
	} while (ret);

	os_init_mdot();
	os_init_zedf9p();
}
```

## include/main.h
```c
/**   
 ***************************************************************
 * @file    apps/thesis/include/main.h   
 * @author  Lewis Ainslie - s4485827  
 * @date    08/11/2021   
 * @brief   Main header file for includes    
 ***************************************************************
 */


#ifndef MAIN_H
#define MAIN_H

#include <zephyr.h>
#include <device.h>
#include <devicetree.h>
#include <init.h>
#include <drivers/gpio.h>
#include <drivers/uart.h>

#include <stdio.h>
#include <stdlib.h>
#include <string.h>
#include <math.h>

#endif
```
