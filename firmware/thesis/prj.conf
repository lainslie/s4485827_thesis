## prj.conf
```kconfig
# CONFIG_SERIAL=y

# # CONFIG_HEAP_MEM_POOL_SIZE=5
# CONFIG_SYS_POWER_MANAGEMENT=y

# CONFIG_COUNTER=y

# CONFIG_DEVICE_POWER_MANAGEMENT=y


# CONFIG_THREAD_NAME=y

# CONFIG_SERIAL=y

# CONFIG_HEAP_MEM_POOL_SIZE=1024

# CONFIG_THREAD_NAME=y


CONFIG_SERIAL=y

CONFIG_HEAP_MEM_POOL_SIZE=1024

CONFIG_THREAD_NAME=y
```

## boards/disco_l475_iot1.conf
```kconfig
CONFIG_PRINTK=y

CONFIG_LOG=y

CONFIG_INIT_STACKS=y
CONFIG_THREAD_STACK_INFO=y
CONFIG_KERNEL_SHELL=y
CONFIG_THREAD_MONITOR=y
CONFIG_BOOT_BANNER=n
CONFIG_THREAD_NAME=y

CONFIG_DEVICE_SHELL=y

CONFIG_HEAP_MEM_POOL_SIZE=512

CONFIG_GPIO=y
```

## src/main.c
```c
/**   
 ***************************************************************
 * @file    apps/p3/src/main.c    
 * @author  Lewis Ainslie - s4485827  
 * @date    08/03/2021   
 * @brief   Main file enabling all functionality for different devices
 ***************************************************************
 */

#include "main.h"
#include "os_zedf9p.h"
#include "os_mdot.h"







void main(void) {

	int ret = -1;

	// struct device* adev = device_get_binding("UART_1");
	// char test = 'a';

	// char buffer[20] = "stressed";
	// int i = 0;
	// while (1) {
	// for (int i = 0; i < 10; i++) {
	// 	uart_poll_out(adev, buffer[i]);
	// 	k_msleep(100);


	// }
	// }
	

	do {
		ret = 0;
		ret += hal_init_mdot();
		ret += hal_init_zedf9p();
		ret = 0;
		k_msleep(1000);
	} while (ret);

	os_init_mdot();
	os_init_zedf9p();
}
```

## include/main.h
```c
/**   
 ***************************************************************
 * @file    apps/p3/include/main.h   
 * @author  Lewis Ainslie - s4485827  
 * @date    08/03/2021   
 * @brief   Main header file for including    
 ***************************************************************
 */


#ifndef MAIN_H
#define MAIN_H

#include <zephyr.h>
#include <device.h>
#include <devicetree.h>
#include <init.h>
#include <drivers/gpio.h>

#include <drivers/uart.h>




#include <stdio.h>
#include <stdlib.h>
#include <string.h>
#include <math.h>


// extern struct shell* shell_used;

// #include <shell/shell_uart.h>



#endif
```
