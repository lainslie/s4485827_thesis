/*
 * Copyright (c) 2020, Nordic Semiconductor ASA
 *
 * SPDX-License-Identifier: Apache-2.0
 */

/* overlay file for the disco_l475_iot1 to overwrite SPI */

&usart3 {
	status = "okay";
	pinctrl-0 = < &usart3_tx_pc4 &usart3_rx_pc5 >;
	current-speed = < 0x1c200 >;
};

&uart4 {
	
	current-speed = < 57600 >;
};


