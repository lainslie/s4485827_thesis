## thesis/boards/nucleo_l152re.conf
```kconfig
CONFIG_PRINTK=y

CONFIG_LOG=y

CONFIG_INIT_STACKS=y
CONFIG_THREAD_STACK_INFO=y
CONFIG_KERNEL_SHELL=y
CONFIG_THREAD_MONITOR=y
CONFIG_BOOT_BANNER=n
CONFIG_THREAD_NAME=y

CONFIG_DEVICE_SHELL=y

CONFIG_HEAP_MEM_POOL_SIZE=512

CONFIG_GPIO=y
```
